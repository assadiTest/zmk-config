## config/west.yml
```yaml
manifest:
  remotes:
    - name: zmkfirmware
      url-base: https://github.com/zmkfirmware
    - name: urob
      url-base: https://github.com/urob
  projects:
    - name: zmk
      remote: zmkfirmware
      revision: main
      import: app/west.yml
    - name: zmk-adaptive-key
      path: modules/zmk/adaptive-key
      remote: urob
      revision: main
    - name: zmk-auto-layer
      path: modules/zmk/auto-layer
      remote: urob
      revision: main
    - name: zmk-helpers
      path: modules/zmk/helpers
      remote: urob
      revision: main
    - name: zmk-leader-key
      path: modules/zmk/leader-key
      remote: urob
      revision: main
    - name: zmk-tri-state
      path: modules/zmk/tri-state
      remote: urob
      revision: main
    - name: zmk-unicode
      path: modules/zmk/unicode
      remote: urob
      revision: main
  self:
    path: config
```
