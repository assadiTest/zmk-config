#include <behaviors.dtsi>
#include <behaviors/num_word.dtsi> // Requires zmk-auto-layer module.
#include <behaviors/unicode.dtsi> // Requires zmk-unicode module.
//#include "helper.h" // Requires zmk-helpers module.
#include <zmk-helpers/helper.h> // Requires zmk-helpers module.
#include <dt-bindings/zmk/ext_power.h>
#include <dt-bindings/zmk/keys.h>
#include <dt-bindings/zmk/bt.h>
#include <dt-bindings/zmk/outputs.h>
#include "zmk-helpers/key-labels/hillside46.h"

#define DEF 0
#define NAV 1
#define MOUSE 2
#define MEDIA 3
#define SYMBOL 4
#define NUM 5
#define FN 6

#define XXX &none
#define ___ &trans

/* Global defaults */

#define QUICK_TAP_MS 200

&sk {
  release-after-ms = <900>;
  quick-release;
};

&sl { // Allow sticky mods to chord across sticky layers.
  ignore-modifiers;
};

&lt {
  flavor = "balanced";
  tapping-term-ms = <200>;
  quick-tap-ms = <QUICK_TAP_MS>;
};

/* Homerow mods */

#define KEYS_L LT5 LT4 LT3 LT2 LT1 LT0 LM5 LM4 LM3 LM2 LM1 LM0 LB5 LB4 LB3 LB2 LB1 LB0
#define KEYS_R RT0 RT1 RT2 RT3 RT4 RT5 RM0 RM1 RM2 RM3 RM4 RM5 RB0 RB1 RB2 RB3 RB4 RB5
#define KEYS_T LH4 LH3 LH2 LH1 LH0 RH0 RH1 RH2 RH3 RH4

//urob key matrix
//#define KEYS_L LT0 LT1 LT2 LT3 LT4 LM0 LM1 LM2 LM3 LM4 LB0 LB1 LB2 LB3 LB4
//#define KEYS_R RT0 RT1 RT2 RT3 RT4 RM0 RM1 RM2 RM3 RM4 RB0 RB1 RB2 RB3 RB4
//#ifndef LH2
//  #define THUMBS LH1 LH0 RH0 RH1         // Thumbs on 34 keys.
//#else
//  #define THUMBS LH2 LH1 LH0 RH0 RH1 RH2 // Thumbs on 36+ keys.
//#endif


#define MAKE_HRM(NAME, HOLD, TAP, TRIGGER_POS)                                 \
  ZMK_HOLD_TAP(NAME, bindings = <HOLD>, <TAP>; flavor = "balanced";            \
               tapping-term-ms = <280>; quick-tap-ms = <QUICK_TAP_MS>;         \
               require-prior-idle-ms = <150>; hold-trigger-on-release;         \
               hold-trigger-key-positions = <TRIGGER_POS>;)


#define HM_TAPPING_TERM 280

MAKE_HRM(hml, &kp, &kp, KEYS_R KEYS_T) // Left-hand HRMs.
MAKE_HRM(hmr, &kp, &kp, KEYS_L KEYS_T) // Right-hand HRMs.

// Hack: Make HRM combos tap-only (cf, ZMK issue #544).
#define ZMK_COMBO_8(NAME, TAP, POS, LAYERS, COMBO_MS, IDLE_MS, HOLD, SIDE)     \
  MAKE_HRM(hm_combo_##NAME, &kp, TAP, SIDE KEYS_T)                             \
  ZMK_COMBO_6(NAME, &hm_combo_##NAME HOLD 0, POS, LAYERS, COMBO_MS, IDLE_MS)

/* Combos, leader key sequences, mouse emulation */

#include "combos.dtsi" // Must be sourced after HRM-combo hack.
#include "leader.dtsi"
#include "mouse.dtsi"

/* Nav cluster */

// Trigger tap-action on all interrupts.
#define MT_CORE                                                                \
  flavor = "tap-preferred";                                                    \
  tapping-term-ms = <220>;                                                     \
  quick-tap-ms = <220>;                                                        \
  hold-trigger-key-positions = <0>;

&mt { MT_CORE };

ZMK_HOLD_TAP(mt_home, bindings = <&masked_home>, <&kp>; MT_CORE)
ZMK_HOLD_TAP(mt_end, bindings = <&masked_end>, <&kp>; MT_CORE)

#define NAV_LEFT  &mt_home 0   LEFT  // Tap: left  | Long-tap: start of line.
#define NAV_RIGHT &mt_end 0    RIGHT // Tap: right | Long-tap: end   of line.
#define NAV_UP    &mt LC(HOME) UP    // Tap: up    | Long-tap: start of doc.
#define NAV_DOWN  &mt LC(END)  DOWN  // Tap: down  | Long-tap: end   of doc.
#define NAV_BSPC  &mt LC(BSPC) BSPC  // Tap: bspc  | Long-tap: delete word bwd.
#define NAV_DEL   &mt LC(DEL)  DEL   // Tap: del   | Long-tap: delete word fwd.

// Mask CTRL on left/right hold to avoid accidental jumps to start/end of doc.
#define MASK_MODS(NAME, MODS, BINDING)                                         \
  ZMK_MOD_MORPH(NAME, bindings = <BINDING>, <BINDING>; mods = <MODS>;)

MASK_MODS(masked_home, (MOD_LCTL), &kp HOME)
MASK_MODS(masked_end,  (MOD_LCTL), &kp END)

/* Magic-shift & auto-layers */

// Tap: repeat after alpha, else sticky-shift |
// Shift + tap/ double-tap: caps-word | Hold: shift.
// #define MAGIC_SHIFT &magic_shift LSHFT 0
//ZMK_HOLD_TAP(magic_shift, bindings = <&kp>, <&magic_shift_tap>;
//             flavor = "balanced"; tapping-term-ms = <200>;
//             quick-tap-ms = <QUICK_TAP_MS>;)
//ZMK_MOD_MORPH(magic_shift_tap, bindings = <&shift_repeat>, <&caps_word>;
//              mods = <(MOD_LSFT)>;)
ZMK_ADAPTIVE_KEY(
    shift_repeat, bindings = <&sk LSHFT>;
    repeat {
      trigger-keys = <A B C D E F G H I J K L M N O P Q R S T U V W X Y Z>;
      bindings = <&key_repeat>;
      max-prior-idle-ms = <1200>;
      strict-modifiers;
    };)
&caps_word { // Mods deactivate caps-word, requires PR #1451. [TODO: rebase]
  /delete-property/ ignore-modifiers;
};

// Tap: num-word | double-tap: sticky num-layer | Hold: num-layer.
#define SMART_NUM &smart_num NUM 0
ZMK_HOLD_TAP(smart_num, bindings = <&mo>, <&num_dance>; flavor = "balanced";
             tapping-term-ms = <200>; quick-tap-ms = <QUICK_TAP_MS>;)
ZMK_TAP_DANCE(num_dance, bindings = <&num_word NUM>, <&sl NUM>;
              tapping-term-ms = <200>;)

// Smart-mouse, requires tri-state module.
ZMK_TRI_STATE(
    smart_mouse, bindings = <&tog MOUSE>, <&none>, <&tog MOUSE>;
    ignored-key-positions =
        <LH2 RM2 RM3 RM4 RB1 RB2 RB3 RB4 RH0 RH1 RH2>;
    ignored-layers = <MOUSE NAV FN>;)

/* Custom behaviors */

// Alt+Tab swapper, requires tri-state module.
ZMK_TRI_STATE(swapper, bindings = <&kt LALT>, <&kp TAB>, <&kt LALT>;
              ignored-key-positions = <LT2 RT2 RM1 RM2 RM3>;)

// Define mod-morph with a *single* mod trigger for less repetition.
#define SIMPLE_MORPH(NAME, MOD, BINDING1, BINDING2)                            \
  ZMK_MOD_MORPH(NAME, mods = <(MOD_L##MOD | MOD_R##MOD)>;                      \
                bindings = <BINDING1>, <BINDING2>;)

// Tap: comma | Shift + tap: semicolon | Ctrl + shift + tap: <.
SIMPLE_MORPH(comma_morph, SFT, &kp COMMA, &comma_inner_morph)
SIMPLE_MORPH(comma_inner_morph, CTL, &kp SEMICOLON, &kp LESS_THAN)

// Tap: dot | Shift + tap: colon | Ctrl + shift + tap: >.
SIMPLE_MORPH(dot_morph, SFT, &kp DOT, &dot_inner_morph)
SIMPLE_MORPH(dot_inner_morph, CTL, &kp COLON, &kp GREATER_THAN)

// Tap: qmark | Shift + tap: excl.
SIMPLE_MORPH(qexcl, SFT, &kp QMARK, &kp EXCL)

// Tap: left/right parenthesis | Shft + tap: less-than/greater-than.
SIMPLE_MORPH(lpar_lt, SFT, &kp LPAR, &kp LT)
SIMPLE_MORPH(rpar_gt, SFT, &kp RPAR, &kp GT)

// Tap: space | Shift + tap: dot -> space -> sticky shift | Hold: nav layer.
ZMK_HOLD_TAP(lt_spc, bindings = <&mo>, <&spc_morph>; flavor = "balanced";
             tapping-term-ms = <200>; quick-tap-ms = <QUICK_TAP_MS>;)
SIMPLE_MORPH(spc_morph, SFT, &kp SPACE, &dot_spc)
ZMK_MACRO(dot_spc, bindings = <&kp DOT &kp SPACE &sk LSHFT>; wait-ms = <0>;
          tap-ms = <5>;)

// Tap: backspace | Lshft + tap: delete | Rshft + tap: shift-delete.
//ZMK_MOD_MORPH(bs_del, bindings = <&kp BSPC>, <&kp DEL>;
//              mods = <(MOD_LSFT|MOD_RSFT)>; keep-mods = <MOD_RSFT>;)

// Tap: copy | double-tap: cut.
//ZMK_TAP_DANCE(copy_cut, bindings = <&kp LC(INS)>, <&kp LC(X)>;
//              tapping-term-ms = <200>;)

// Sticky shift + leader.
ZMK_MACRO(leader_sft, bindings = <&sk LSHFT &leader>;)

// Misc aliases. [TODO: clean up]
//#define CANCEL    &kp K_CANCEL            // Cancel caps-word & auto-layers.
//#define DSK_PREV  &hmr LCTRL LG(LC(LEFT)) // Previous desktop.
//#define DSK_NEXT  &hmr LALT LG(LC(RIGHT)) // Next     desktop.
//#define PIN_WIN   &kp LG(LC(LS(Q)))       // Pin window across desktops.
//#define PIN_APP   &kp LG(LC(LS(A)))       // Pin application across desktops.
//#define DSK_MGR   &kp LA(GRAVE)           // Desktop manager.
//#define VOL_DOWN  &hmr RSHFT C_VOL_DN

/* Keymap */

//ZMK_CONDITIONAL_LAYER(sys, FN NUM, SYS) // FN + NUM --> SYS.

//#ifndef ZMK_BASE_LAYER
//  #define ZMK_BASE_LAYER(name, LT, RT, LM, RM, LB, RB, LH, RH)                 \
//      ZMK_LAYER(name, LT RT LM RM LB RB LH RH)
//#endif



/ {
    behaviors {
      keymap {
        compatible = "zmk,keymap";

        qwerty {
            /* QWERTY
 * -------------------------------------------------------------------------------------------------------------------------------------
 * | `     |   Q   |   W   |   E   |   R   |   T   |-----------------------------------|   Y   |   U   |   I   |   O   |   P   | BKSPC |
 * | TAB   |   A   |   S   |   D   |   F   |   G   |-----------------------------------|   H   |   J   |   K   |   L   |   ;   | ENTER |
 * | CTRL  |   Z   |   X   |   C   |   V   |   B   |  ESC  |-------------------|  CAPS |   N   |   M   |   ,   |   .   |   /   |   '   |
 *                                 |  GUI  |  ALT  |SK SHFT|  Nav  |---|  Sym  | SPACE |  ALT  |  GUI  |
 */
 /*                                      46 KEY MATRIX / LAYOUT MAPPING

  ╭────────────────────────╮               ╭────────────────────────╮
  │  0   1   2   3   4   5 │               │  6   7   8   9  10  11 │
  │ 12  13  14  15  16  17 ╰──╮         ╭──╯ 18  19  20  21  22  23 │
  │ 24  25  26  27  28  29  30╰────┬────╯31  32  33  34  35  36  37 │
  ╰───────────────╮ 38  39  40  41 │ 42  43  44  45 ╭───────────────╯
                  ╰────────────────┴────────────────╯
 ╭─────────────────────────╮               ╭─────────────────────────╮
 │ LT5 LT4 LT3 LT2 LT1 LT0 │               │ RT0 RT1 RT2 RT3 RT4 RT5 │
 │ LM5 LM4 LM3 LM2 LM1 LM0 ╰──╮         ╭──╯ RM0 RM1 RM2 RM3 RM4 RM5 │
 │ LB5 LB4 LB3 LB2 LB1 LB0 LH4╰────┬────╯RH4 RB0 RB1 RB2 RB3 RB4 RB5 │
 ╰───────────────╮ LH3 LH2 LH1 LH0 │ RH0 RH1 RH2 RH3 ╭───────────────╯
                 ╰─────────────────┴───── ───────────╯
 T : Top
 M : Middle
 B : Bottom
 H : Hand
 P : Palm
*/

            bindings = <
&kp GRAVE        &kp Q        &kp W        &kp E         &kp R          &kp T                                                             &kp Y       &kp U         &kp I         &kp O         &kp P           &mt RIGHT_BRACKET LEFT_BRACKET
&mt PIPE EXCL    &hml LGUI A  &hml LALT S  &hml LCTRL D  &hml LSHIFT F  &kp G                                                             &kp H       &hmr RSHFT J  &hmr RCTRL K  &hmr LALT L   &hmr LGUI SEMI  &mt UNDER MINUS
&mt TILDE ASTRK  &kp Z        &kp X        &kp C         &kp V          &kp B         &kp K_APP                              &caps_word   &kp N       &kp M         &kp COMMA     &kp DOT       &kp SLASH       &mt DQT SQT
                                                         &key_repeat    &lt 1 ESCAPE  &lt 2 SPACE  &lt 3 TAB     &lt 4 RET   &lt 5 BSPC   &lt 6 DEL   &key_repeat
            >;
        };

        Nav {
            bindings = <
&trans  &trans    &trans    &trans     &trans     &trans                                       &kp K_UNDO    &kp HOME  &kp PG_DN   &kp PG_UP    &kp END    &trans
&trans  &kp LGUI  &kp LALT  &kp LCTRL  &kp LSHFT  &trans                                       &kp CAPSLOCK  &kp LEFT  &kp DOWN    &kp UP       &kp RIGHT  &trans
&trans  &trans    &trans    &trans     &trans     &trans  &trans                     &trans    &kp K_REDO    &kp INS   &kp K_COPY  &kp K_PASTE  &kp K_CUT  &trans
                                       &trans     &trans  &trans  &trans  &kp ENTER  &kp BSPC  &kp DELETE    &trans
            >;

            label = "Nav";
        };

        Mouse {
            bindings = <
&trans  &trans    &trans    &trans     &trans     &trans                                        &trans     &trans          &trans          &trans        &trans           &trans
&trans  &kp LGUI  &kp LALT  &kp LCTRL  &kp LSHFT  &trans                                        &trans     U_MS_L          U_MS_D          U_MS_U        U_MS_R           &trans
&trans  &trans    &trans    &trans     &trans     &trans  &trans                     &trans     &trans     U_WH_L          U_WH_D          U_WH_U        U_WH_D           &trans
                                       &trans     &trans  &trans  &trans  &mkp MCLK  &mkp LCLK  &mkp RCLK  &trans
            >;

            label = "Mouse";
        };

        Media {
            bindings = <
&trans  &trans    &trans    &trans     &trans     &trans                                                &trans             &trans               &out OUT_TOG  &trans        &trans                     &trans
&trans  &kp LGUI  &kp LALT  &kp LCTRL  &kp LSHFT  &trans                                                &ext_power EP_TOG  &mt C_REWIND C_PREV  &kp C_VOL_DN  &kp C_VOL_UP  &mt C_FAST_FORWARD C_NEXT  &trans
&trans  &trans    &trans    &trans     &trans     &trans  &trans                      &bt BT_CLR        &bt BT_SEL 0       &bt BT_SEL 1         &bt BT_SEL 2  &bt BT_SEL 3  &bt BT_SEL 4               &key_repeat
                                       &trans     &trans  &trans  &trans  &kp C_STOP  &kp C_PLAY_PAUSE  &kp C_MUTE         &trans
            >;

            label = "Media";
        };

        Sym {
            bindings = <
&kp KP_NUMLOCK  &kp EXCL  &kp DOLLAR   &kp AMPERSAND  &kp LEFT_PARENTHESIS  &kp RIGHT_PARENTHESIS                                  &trans  &trans      &trans     &trans    &trans    &trans
&kp COLON       &kp AT    &kp PERCENT  &kp ASTERISK   &kp LEFT_BRACKET      &kp RIGHT_BRACKET                                      &trans  &kp LSHIFT  &kp LCTRL  &kp LALT  &kp LGUI  &trans
&kp TILDE       &kp HASH  &kp CARET    &kp PIPE       &kp LEFT_BRACE        &kp RIGHT_BRACE        &trans                  &trans  &trans  &trans      &trans     &trans    &trans    &trans
                                                      &trans                &trans                 &trans  &trans  &trans  &trans  &trans  &trans
            >;

            label = "Sym";
        };

        Num {
            bindings = <
&kp KP_COMMA  &kp KP_PLUS  &kp N7  &kp N4  &kp N1  &kp EQUAL                                     &trans  &trans     &trans     &trans    &trans    &trans
&kp COLON     &kp TAB      &kp N8  &kp N5  &kp N2  &kp FSLH                                      &trans  &kp RSHFT  &kp RCTRL  &kp RALT  &kp RGUI  &trans
&kp STAR      &kp RET      &kp N9  &kp N6  &kp N3  &kp BSLH   &trans                     &trans  &trans  &trans     &trans     &trans    &trans    &trans
                                           &trans  &kp DOT    &kp N0  &kp MINUS  &trans  &trans  &trans  &trans
            >;

            label = "Num";
        };

        Fun {
            bindings = <
&trans  &kp F10  &kp F7  &kp F4  &kp F1  &kp PRINTSCREEN                                  &trans  &kp F13         &kp F16        &kp F19       &kp F22       &trans
&trans  &kp F11  &kp F8  &kp F5  &kp F2  &kp SCROLLLOCK                                   &trans  &mt LSHIFT F14  &mt LCTRL F17  &mt LALT F20  &mt LGUI F22  &trans
&trans  &kp F12  &kp F9  &kp F6  &kp F3  &kp PAUSE_BREAK  &trans                  &trans  &trans  &kp F15         &kp F18        &kp F21       &kp F24       &trans
                                 &trans  &trans           &trans  &trans  &trans  &trans  &trans  &trans
            >;

            label = "Fun";
        }; 
      };

    };
};
